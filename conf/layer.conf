## conf/layer.conf
```bitbake
# FirmCraft BSP Layer Configuration
BBPATH .= ":${LAYERDIR}"

# Include all recipes and appends
BBFILES += "${LAYERDIR}/recipes-*/*/*.bb \
            ${LAYERDIR}/recipes-*/*/*.bbappend"

BBFILE_COLLECTIONS += "firmcraft-bsp"
BBFILE_PATTERN_firmcraft-bsp := "^${LAYERDIR}/"
BBFILE_PRIORITY_firmcraft-bsp = "10"

# Layer version
LAYERVERSION_firmcraft-bsp = "2"

# Compatible with Yocto Scarthgap release
LAYERSERIES_COMPAT_firmcraft-bsp = "scarthgap"

# Layer dependencies
LAYERDEPENDS_firmcraft-bsp = " \
    core \
    openembedded-layer \
"

# Recommended layers (optional but beneficial)
LAYERRECOMMENDS_firmcraft-bsp = " \
    meta-ti \
    meta-arm \
"
```

## conf/machine/beagleblack.conf
```bitbake
#@TYPE: Machine
#@NAME: BeagleBone Black
#@DESCRIPTION: FirmCraft BSP for BeagleBone Black with advanced features

require conf/machine/include/beaglebone.inc

# Machine identification
MACHINEOVERRIDES =. "beaglebone:"
MACHINE = "beaglebone-yocto"

# Kernel configuration
PREFERRED_PROVIDER_virtual/kernel = "linux-ti-staging"
KERNEL_IMAGETYPE = "zImage"
KERNEL_DEVICETREE = " \
    am335x-boneblack.dtb \
    am335x-boneblack-wireless.dtb \
    am335x-bonegreen.dtb \
    am335x-bonegreen-wireless.dtb \
"

# Boot loader configuration
PREFERRED_PROVIDER_virtual/bootloader = "u-boot-ti-staging"
PREFERRED_PROVIDER_u-boot = "u-boot-ti-staging"
SPL_BINARY = "MLO"
UBOOT_SUFFIX = "img"
UBOOT_MACHINE = "am335x_evm_config"
UBOOT_ENTRYPOINT = "0x80008000"
UBOOT_LOADADDRESS = "0x80008000"

# Serial console configuration
SERIAL_CONSOLES = "115200;ttyS0"
SERIAL_CONSOLES_CHECK = "${SERIAL_CONSOLES}"

# WKS file for disk image creation
WKS_FILE = "beaglebone-yocto.wks"

# Image features and formats
IMAGE_FSTYPES += "tar.xz wic.xz wic.bmap"
IMAGE_BOOT_FILES = " \
    u-boot.${UBOOT_SUFFIX} \
    MLO \
    ${KERNEL_IMAGETYPE} \
    ${KERNEL_DEVICETREE} \
"

# Hardware features
MACHINE_FEATURES = "usbgadget usbhost vfat ext2 serial ethernet screen apm"
MACHINE_EXTRA_RRECOMMENDS = "kernel-modules kernel-devicetree"

# CPU and tuning
DEFAULTTUNE ?= "cortexa8thf-neon"
require conf/machine/include/arm/armv7a/tune-cortexa8.inc

# GPU configuration (SGX530)
PREFERRED_PROVIDER_virtual/egl = "ti-sgx-ddk-um"
PREFERRED_PROVIDER_virtual/libgles1 = "ti-sgx-ddk-um"
PREFERRED_PROVIDER_virtual/libgles2 = "ti-sgx-ddk-um"
PREFERRED_PROVIDER_virtual/libgbm = "ti-sgx-ddk-um"

# PRU (Programmable Real-Time Unit) support
MACHINE_FEATURES += "pru"

# Extra firmware
MACHINE_ESSENTIAL_EXTRA_RDEPENDS += "kernel-image kernel-devicetree"

# Kernel module autoloading
KERNEL_MODULE_AUTOLOAD += "g_ether"
```

## conf/machine/rpi4.conf
```bitbake
require conf/machine/raspberrypi4-64.conf
MACHINE = "raspberrypi4-64"
PREFERRED_PROVIDER_virtual/kernel = "linux-raspberrypi"
LICENSE_FLAGS_ACCEPTED += "synaptics-killswitch"
```
